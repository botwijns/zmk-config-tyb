## boards/shields/tyb/Kconfig.defconfig
```kconfig
if SHIELD_TYB_LEFT

config ZMK_KEYBOARD_NAME
    default "tyb"

config ZMK_SPLIT_ROLE_CENTRAL
    default y

endif # SHIELD_TYB_LEFT

if SHIELD_TYB_LEFT || SHIELD_TYB_RIGHT

config ZMK_SPLIT
    default y

endif # SHIELD_TYB_LEFT || SHIELD_TYB_RIGHT
```

## boards/shields/tyb/Kconfig.shield
```kconfig
config SHIELD_TYB_LEFT
    def_bool $(shields_list_contains,tyb_left)

config SHIELD_TYB_RIGHT
    def_bool $(shields_list_contains,tyb_right)
```
